## conf/layer.conf
```bitbake
# We have a conf and classes directory, add to BBPATH
BBPATH .= ":${LAYERDIR}"

# We have recipes-* directories, add to BBFILES
BBFILES += "${LAYERDIR}/recipes-*/*/*.bb \
            ${LAYERDIR}/recipes-*/*/*.bbappend"

BBFILE_COLLECTIONS += "meta-labrador"
BBFILE_PATTERN_meta-labrador = "^${LAYERDIR}/"
BBFILE_PRIORITY_meta-labrador = "6"

LAYERDEPENDS_meta-labrador = "core"
LAYERSERIES_COMPAT_meta-labrador = "gatesgarth"
```

## conf/machine/labrador-v2.conf
```bitbake
require conf/machine/include/tune-cortexa9.inc

DEFAULTTUNE = "armv7ahf"

PREFERRED_PROVIDER_virtual/kernel = "linux-microhobby"
PREFERRED_VERSION_linux-yocto ??= "5.11%"
# KBUILD_DEFCONFIG = "multi_v7_defconfig"
# KERNEL_IMAGETYPE = "uImage"
KERNEL_IMAGETYPE = "zImage"
KERNEL_DEVICETREE = "owl-s500-labrador-base-m.dtb"
# UBOOT_ENTRYPOINT = "0x00008000"
# UBOOT_LOADADDRESS = "0x00008000"

IMAGE_FSTYPES = "wic"
WKS_FILE = "labrador-boot.wks"
IMAGE_BOOT_FILES = "zImage owl-s500-labrador-base-m-labrador-v2.dtb uEnv.txt"

KERNEL_EXTRA_ARGS += "LOADADDR=${UBOOT_ENTRYPOINT}"

MACHINE_FEATURES_remove = "rtc qemu-usermode"

# DISTRO_FEATURES_append = " systemd"
# DISTRO_FEATURES_BACKFILL_CONSIDERED += "sysvinit"
# VIRTUAL-RUNTIME_init_manager = "systemd"
# VIRTUAL-RUNTIME_initscripts = "systemd-compat-units"

# DISTRO_FEATURES="acl alsa argp bluetooth ext2 ipv4 ipv6 largefile pcmcia usbgadget usbhost wifi xattr nfs zeroconf pci 3g nfc x11 vfat largefile opengl ptest multiarch wayland vulkan systemd pulseaudio gobject-introspection-data ldconfig"
# DISTRO_FEATURES = "acl argp ipv4 ipv6 largefile pcmcia usbgadget usbhost xattr nfs vfat largefile multiarch systemd gobject-introspection-data ldconfig"

KERNEL_FEATURES = " "
```

## wic/labrador-boot.wks
```
# part 1bootloader --source rawcopy --sourceparams="file=bootloader.bin" --ondisk mmcblk --no-table --offset "1"

part u-boot     --source rawcopy --sourceparams="file=u-boot-dtb.img"   --ondisk mmcblk0 --no-table                 --offset 33
part /boot      --source bootimg-partition                              --ondisk mmcblk0 --fstype=vfat --label boot --align 8192 --size 32
part /          --source rootfs                                         --ondisk mmcblk0 --fstype=ext4 --label root --align 8192

bootloader --ptable msdos
```
